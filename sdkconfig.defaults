## sdkconfig.defaults
```kconfig
# （ESP32-C6）芯片目标选择
CONFIG_SLAVE_IDF_TARGET_ESP32C6=y
CONFIG_ESP_HOSTED_CP_TARGET_ESP32C6=y

# 适配 ESP32-P4 功能开发板 SDIO Wi-Fi 硬件配置
CONFIG_ESP_HOSTED_P4_DEV_BOARD_FUNC_BOARD=y

#  Wi-Fi 远端数据缓冲区性能配置
CONFIG_WIFI_RMT_STATIC_RX_BUFFER_NUM=16
CONFIG_WIFI_RMT_DYNAMIC_RX_BUFFER_NUM=64
CONFIG_WIFI_RMT_DYNAMIC_TX_BUFFER_NUM=64
CONFIG_WIFI_RMT_AMPDU_TX_ENABLED=y
CONFIG_WIFI_RMT_TX_BA_WIN=32
CONFIG_WIFI_RMT_AMPDU_RX_ENABLED=y
CONFIG_WIFI_RMT_RX_BA_WIN=32

# TCP/IP 协议栈配置
CONFIG_LWIP_TCP_SND_BUF_DEFAULT=65534
CONFIG_LWIP_TCP_WND_DEFAULT=65534
CONFIG_LWIP_TCP_RECVMBOX_SIZE=64
CONFIG_LWIP_UDP_RECVMBOX_SIZE=64
CONFIG_LWIP_TCPIP_RECVMBOX_SIZE=64

CONFIG_LWIP_TCP_SACK_OUT=y


CONFIG_ESP_TLS_ENABLED=y
CONFIG_ESP_TLS_WITH_MBEDTLS=y
CONFIG_MBEDTLS_SSL_MAX_CONTENT_LEN=4096


CONFIG_MBEDTLS_EXTERNAL_MEM_ALLOC=y

# 启用 TLS 1.2 和 TLS 1.3 支持
CONFIG_MBEDTLS_SSL_PROTO_TLS1_2=y
CONFIG_MBEDTLS_SSL_PROTO_TLS1_3=y

# 启用证书验证
CONFIG_MBEDTLS_CERTIFICATE_BUNDLE=y
CONFIG_MBEDTLS_CERTIFICATE_BUNDLE_DEFAULT_FULL=y

# HTTP Client
CONFIG_ESP_HTTP_CLIENT_ENABLE_HTTPS=y

# JSON 支持
CONFIG_JSON_ENABLE_STRING_AUTO_ESCAPE=n

# 任务内存扩展
CONFIG_FREERTOS_TASK_CREATE_ALLOW_EXT_MEM=y


# 任务超时保护
CONFIG_ESP_TASK_WDT_TIMEOUT_S=60

# LVGL 拼音输入法
CONFIG_LV_USE_IME_PINYIN=y
CONFIG_LV_IME_PINYIN_USE_DEFAULT_DICT=n
CONFIG_LV_IME_PINYIN_CAND_TEXT_NUM=8

# 仅返回错误码，不触发断言
CONFIG_BSP_ERROR_CHECK=n

# 摄像头驱动：OV5647，MIPI RAW8 800×800 50帧
CONFIG_CAMERA_OV5647=y
CONFIG_CAMERA_OV5647_AUTO_DETECT_MIPI_INTERFACE_SENSOR=y
CONFIG_CAMERA_OV5647_MIPI_RAW8_800X800_50FPS=y
CONFIG_CAMERA_OV5647_MIPI_DEFAULT_FMT_RAW8_800X800_50FPS=y
CONFIG_CAMERA_OV5647_CSI_LINESYNC_ENABLE=y
CONFIG_CAMERA_OV5647_CUSTOMIZED_IPA_JSON_CONFIGURATION_FILE=y
CONFIG_CAMERA_OV5647_CUSTOMIZED_IPA_JSON_CONFIGURATION_FILE_PATH="who_components/who_peripherals/who_cam/who_p4_cam/ov5647.json"
```

## sdkconfig.defaults.esp32p4
```kconfig
CONFIG_IDF_TARGET="esp32p4"
CONFIG_ESPTOOLPY_FLASHMODE_QIO=y
CONFIG_ESPTOOLPY_FLASHSIZE_16MB=y
CONFIG_MODEL_IN_SDCARD=y
CONFIG_SR_VADN_VADNET1_MEDIUM=y
CONFIG_SR_WN_WN9_HILEXIN=y
CONFIG_SR_MN_CN_MULTINET7_QUANT=y
CONFIG_CACHE_L2_CACHE_256KB=y
CONFIG_CACHE_L2_CACHE_LINE_128B=y
CONFIG_SPIRAM=y
CONFIG_SPIRAM_SPEED_200M=y
CONFIG_CACHE_L2_CACHE_256KB=y
CONFIG_CACHE_L2_CACHE_LINE_128B=y
CONFIG_IDF_EXPERIMENTAL_FEATURES=y

# 摄像头驱动：OV5647，MIPI RAW8 800×800 50帧
CONFIG_CAMERA_OV5647=y
CONFIG_CAMERA_OV5647_AUTO_DETECT_MIPI_INTERFACE_SENSOR=y
CONFIG_CAMERA_OV5647_MIPI_RAW8_800X800_50FPS=y
CONFIG_CAMERA_OV5647_MIPI_DEFAULT_FMT_RAW8_800X800_50FPS=y
CONFIG_CAMERA_OV5647_CSI_LINESYNC_ENABLE=y
CONFIG_CAMERA_OV5647_CUSTOMIZED_IPA_JSON_CONFIGURATION_FILE=y
CONFIG_CAMERA_OV5647_CUSTOMIZED_IPA_JSON_CONFIGURATION_FILE_PATH="who_components/who_peripherals/who_cam/who_p4_cam/ov5647.json"
```
